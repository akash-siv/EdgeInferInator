#include <WiFi.h>
#include <ArduinoHA.h>
#include <Tutorial_Continuous_motion_recognition_R2_inferencing.h>
#include <HTTPClient.h>

#define FREQUENCY_HZ        EI_CLASSIFIER_FREQUENCY
#define INTERVAL_MS         (1000 / (FREQUENCY_HZ + 1))
#define BROKER_ADDR         IPAddress(192,168,176,231)
#define WIFI_SSID           "Nothing_Phone_(2a)_1131"
#define WIFI_PASSWORD       "ykdcig35iiaj5jno"
#define HA_USER             "hacktrent"
#define HA_PASS             "hacktrent"
#define NUM_FEATURE_SETS    6
#define FEATURE_LENGTH      EI_CLASSIFIER_DSP_INPUT_FRAME_SIZE

const char* serverName = "https://us-east-1.aws.data.mongodb-api.com/app/data-zvqsdey/endpoint/data/v1/action/insertOne";
const char* apiKey = "IwI3jHXfhOogBqwtV51BGXUaM1pU7TrbZhqaouMe4HqZqqccEYfbtgGj8AXkJMRN";

WiFiClient client;
HADevice device;
HAMqtt mqtt(client, device);

HABinarySensor class1("circle");
HABinarySensor class2("four");
HABinarySensor class3("go");
HABinarySensor class4("rotate");
HABinarySensor class5("waving");

static unsigned long last_interval_ms = 0;

const float feature_sets[NUM_FEATURE_SETS][FEATURE_LENGTH] = {
    {         
      6.6100, -3.7000, 6.4100, -4.5200, 6.2200, -5.1600, 6.3800, -5.7700, 6.6100, -6.0500, 6.9600, -5.8800,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 5.1200
    }, // Circle data
    {         
      1.9700, -14.5900, 2.0700, -14.6100, 2.0200, -14.7500, 1.7700, -14.6400, 1.3900, -14.1400, 1.0900, -13.5800,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 -0.6700, -11.3300        // ... (continue with modified values)
    
    }, // Four data
    {         
      8.3200, -20.0300, 7.6100, -20.7600, 6.7500, -19.9000, 6.0200, -17.8900, 5.4600, -16.0800, 5.4800, -14.2700,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 -14.2700
    }, // Go data
    {        
      6.0300, -4.4300, 6.3800, -3.5900, 6.1900, -2.7300, 6.0600, -1.9100, 5.9300, -1.1200, 6.0600, -0.1400,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 5.6600
    }, // Rotate data
    {         
      9.2700, -5.4800, 8.5500, -4.6000, 7.8100, -3.4000, 7.1000, -2.4900, 6.3200, -1.4700, 5.4200, -0.4400,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 -2.2800    
    }, // Waving data
    { 
      0.3022, 2.8348, -1.2443,-0.8113,-0.3746,0.861,4.7896,1.9324,-0.2094,2.6205,3.8736, 3.5716,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 12.3212
    } // Anomaly data
};

static int current_feature_set = 0;
float temperature = 0;

void setup() {
    Serial.begin(115200);

    // Unique ID must be set!
    byte mac[] = { 0xDE, 0xBE, 0xEB, 0xFE, 0xEF, 0xF0 };
    WiFi.macAddress(mac);
    device.setUniqueId(mac, sizeof(mac));

    WiFi.begin(WIFI_SSID, WIFI_PASSWORD);
    while (WiFi.status() != WL_CONNECTED) {
        Serial.println("Connecting to WiFi...");
        delay(500);
    }
    Serial.println("Connected to WiFi");

    // optional device's details
    device.setName("AnamolyDetector");
    device.setSoftwareVersion("1.0.0");

    // optional properties
    class1.setCurrentState(LOW);
    class1.setName("circle");
    class1.setDeviceClass("door");
    class1.setIcon("mdi:fire");

    class2.setCurrentState(LOW);
    class2.setName("four");
    class2.setDeviceClass("door");
    class2.setIcon("mdi:fire");

    class3.setCurrentState(LOW);
    class3.setName("go");
    class3.setDeviceClass("door");
    class3.setIcon("mdi:fire");

    class4.setCurrentState(LOW);
    class4.setName("rotate");
    class4.setDeviceClass("door");
    class4.setIcon("mdi:fire");

    class5.setCurrentState(LOW);
    class5.setName("waving");
    class5.setDeviceClass("door");
    class5.setIcon("mdi:fire");   

    mqtt.begin(BROKER_ADDR, HA_USER, HA_PASS);
    // mqtt.begin(BROKER_ADDR);

}

void loop() {
    mqtt.loop();
    
    if (millis() > last_interval_ms + INTERVAL_MS) {

    current_feature_set = random(NUM_FEATURE_SETS);
    ei_printf("Using feature set %d for inference\n", current_feature_set + 1);

    signal_t features_signal;
    features_signal.total_length = FEATURE_LENGTH;
    features_signal.get_data = &raw_feature_get_data;

    ei_impulse_result_t result;
    EI_IMPULSE_ERROR res = run_classifier(&features_signal, &result, false);
    if (res != EI_IMPULSE_OK) {
        ei_printf("ERR: Failed to run classifier (%d)\n", res);
        return;
    }
    // print inference return code
    ei_printf("run_classifier returned: %d\r\n", res);
    print_inference_result(result);

    // delay(3000); // Increased delay to make it easier to read the output

    if (result.classification[0].value > 0.6) class1.setState(!class1.getCurrentState());
    else if (result.classification[1].value > 0.6) class2.setState(!class2.getCurrentState());
    else if (result.classification[2].value > 0.6) class3.setState(!class3.getCurrentState());
    else if (result.classification[3].value > 0.6) class4.setState(!class4.getCurrentState());
    else if (result.classification[4].value > 0.6) class5.setState(!class5.getCurrentState());

    temperature = result.anomaly;

    
      last_interval_ms = millis();
      sendToMongoDB();
    }
}

int raw_feature_get_data(size_t offset, size_t length, float *out_ptr) {
    memcpy(out_ptr, feature_sets[current_feature_set] + offset, length * sizeof(float));
    return 0;
}

void sendToMongoDB() {
    if (WiFi.status() == WL_CONNECTED) {
        HTTPClient http;
        http.begin(serverName);
        http.addHeader("Content-Type", "application/json");
        http.addHeader("Access-Control-Request-Headers", "*");
        http.addHeader("api-key", apiKey);

        // float temperature = 27.5; // Example sensor data
        unsigned long timestamp = millis();
        
        String jsonData = "{";
        jsonData += "\"collection\": \"temp\",";
        jsonData += "\"database\": \"temperatureDatabase\",";
        jsonData += "\"dataSource\": \"TempData\",";
        jsonData += "\"document\": {";
        jsonData += "\"timestamp\": {\"$date\": {\"$numberLong\": \"" + String(timestamp) + "\"}},";
        jsonData += "\"sensor_id\": \"sensor_06\",";
        jsonData += "\"temperature\": {\"$numberDouble\": \"" + String(temperature, 1) + "\"}";
        jsonData += "}}";

        int httpResponseCode = http.POST(jsonData);
        if (httpResponseCode > 0) {
            Serial.println(httpResponseCode);
            Serial.println(http.getString());
        } else {
            Serial.print("Error on sending POST: ");
            Serial.println(httpResponseCode);
        }
        http.end();
    } else {
        Serial.println("WiFi Disconnected");
    }
}

void ei_printf(const char *format, ...) {
    char print_buf[1024];
    va_list args;
    va_start(args, format);
    vsnprintf(print_buf, sizeof(print_buf), format, args);
    va_end(args);
    Serial.write(print_buf);
}

void print_inference_result(ei_impulse_result_t result) {
    // Print how long it took to perform inference
    ei_printf("Timing: DSP %d ms, inference %d ms, anomaly %d ms\r\n",
            result.timing.dsp,
            result.timing.classification,
            result.timing.anomaly);

    // Print the prediction results (object detection)
#if EI_CLASSIFIER_OBJECT_DETECTION == 1
    return

    // Print the prediction results (classification)
#else
    ei_printf("Predictions for feature set %d:\r\n", current_feature_set + 1);
    for (uint16_t i = 0; i < EI_CLASSIFIER_LABEL_COUNT; i++) {
        ei_printf("  %s: ", ei_classifier_inferencing_categories[i]);
        ei_printf("%.5f\r\n", result.classification[i].value);
    }
#endif

    // Print anomaly result (if it exists)
#if EI_CLASSIFIER_HAS_ANOMALY
    ei_printf("Anomaly prediction: %.3f\r\n", result.anomaly);
#endif

}
